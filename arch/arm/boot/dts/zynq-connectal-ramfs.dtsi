/*
 *  Copyright (C) 2016 Connectal Project
 *
 * This software is licensed under the terms of the GNU General Public
 * License version 2, as published by the Free Software Foundation, and
 * may be copied, distributed, and modified under those terms.
 *
 * This program is distributed in the hope that it will be useful,
 * but WITHOUT ANY WARRANTY; without even the implied warranty of
 * MERCHANTABILITY or FITNESS FOR A PARTICULAR PURPOSE.  See the
 * GNU General Public License for more details.
 */

/ {
	chosen {
		bootargs = "console=ttyPS0,115200 initrd=0x00800000,512K noinitrd init=/init root=/dev/ram rw ip=:::::eth0:dhcp earlyprintk";
		linux,stdout-path = "/amba/serial@e0001000";
	};
};
