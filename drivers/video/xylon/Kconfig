## drivers/video/xylon/Kconfig
```kconfig
source "drivers/video/xylon/xylonfb/Kconfig"
source "drivers/video/xylon/xylonbb/Kconfig"
```

## drivers/video/xylon/xylonbb/Kconfig
```kconfig
menuconfig BB_XYLON
	tristate "Xylon logiBITBLIT frame buffer support"
	depends on ION
	default n
	help
	  Choose this option if you want to use the Xylon logiBITBLIT
```
